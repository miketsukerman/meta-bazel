## conf/layer.conf
```bitbake
# We have a conf and classes directory, append to BBPATH
BBPATH .= ":${LAYERDIR}"

# We have a recipes directory, add to BBFILES
BBFILES += "${LAYERDIR}/recipes*/*/*.bb \
            ${LAYERDIR}/recipes*/*/*.bbappend \ 
            ${LAYERDIR}/recipes*/*/*/*.bbappend \ 
            ${LAYERDIR}/images/*.bb \
            "

BBFILE_COLLECTIONS += "bazel"
BBFILE_PATTERN_bazel := "^${LAYERDIR}/"
BBFILE_PRIORITY_bazel = "20"

LAYERSERIES_COMPAT_bazel = "nanbield"

BBFILES_DYNAMIC += " \
    bazel:${LAYERDIR}/dynamic-layers/bazel/*/*/*.bb \
    bazel:${LAYERDIR}/dynamic-layers/bazel/*/*/*.bbappend \
"
```
